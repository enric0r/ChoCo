#include "Display.h"
#include "ChordEngine.h"
#include "Config.h"
#include <Wire.h>

static const unsigned char PROGMEM logo_1[] = {0x00,0x00,0x00,0x00,0x00,0x00,0x00,0x00,0x00,0x00,0x00,0x03,0xff,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0xff,0xf8};
static const unsigned char PROGMEM logo_2[] = {0x00,0x00,0x00,0x00,0x00,0x00,0x00,0x00,0x00,0x00,0x00,0x00,0x00,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0xff,0xf8};

static String g_statusMessage;
static unsigned long g_statusUntil = 0;

// Simple I2C scanner to help debug display issues on the selected TwoWire bus
static void scanI2C(TwoWire &tw) {
  Serial.println(F("\nScanning I2C bus for devices..."));
  for(uint8_t addr = 1; addr < 127; addr++) {
    tw.beginTransmission(addr);
    uint8_t error = tw.endTransmission();
    if(error == 0) {
      Serial.print(F("I2C device found at address 0x"));
      if(addr < 16) Serial.print("0");
      Serial.println(addr, HEX);
    }
  }
  Serial.println(F("Scan complete.\n"));
}

Adafruit_SSD1306 display(SCREEN_WIDTH, SCREEN_HEIGHT, &Wire1, OLED_RESET);

void setupDisplay() {
  TwoWire &tw = Wire1;

  // Initialize I2C with the correct pins for RP2040
  tw.setSDA(I2C_SDA_PIN);
  tw.setSCL(I2C_SCL_PIN);
  tw.begin();
  tw.setClock(400000); // 400kHz
  
  // Scan I2C bus to see if display is detected
  scanI2C(tw);
  
  Serial.print(F("Initializing display at address 0x"));
  Serial.println(SCREEN_ADDRESS, HEX);

  if(!display.begin(SSD1306_SWITCHCAPVCC, SCREEN_ADDRESS)) {
    Serial.println(F("SSD1306 allocation failed"));
    for(;;);
  }
  display.clearDisplay();
}

void drawSplashScreen() {
  Serial.println("Drawing splash screen...");
  unsigned long start = millis();
  unsigned long duration = 2000; // Reduced from 5000
  unsigned long interval = 500;  // Reduced from 2000
  int count = 0;
  while(millis() - start < duration) {
    display.clearDisplay();
    if (count % 2 == 0) {
      display.drawBitmap(6,10, logo_1, 117, 42, SSD1306_WHITE);
    } else {
      display.drawBitmap(6,10, logo_2, 117, 42, SSD1306_WHITE);
    }
    display.display();
    delay(interval);
    count++;
  }
  
  // Clear display and show initial state after splash
  display.clearDisplay();
  display.setTextSize(1);
  display.setTextColor(SSD1306_WHITE);
  display.setCursor(0, 0);
  display.print("Ready");
  display.display();
  delay(500);
  
  Serial.println("Splash screen complete");
}

void updateDisplay() {
  static unsigned long lastDebug = 0;
  bool shouldDebug = (millis() - lastDebug > 2000);
  
  String chordName = getCurrentChordName();
  
  // Create compact version for display (remove spaces, abbreviate)
  String displayName = chordName;
  displayName.replace(" ", ""); // Remove spaces: "C Maj7/E" -> "CMaj7/E"
  
  if (shouldDebug) {
    Serial.print("updateDisplay() called | chord='");
    Serial.print(chordName);
    Serial.print("' display='");
    Serial.print(displayName);
    Serial.println("'");
    lastDebug = millis();
  }
  
  display.clearDisplay();
  display.setTextColor(SSD1306_WHITE);

  bool hasStatus = (g_statusMessage.length() > 0 && millis() < g_statusUntil);
  
  // Top line - left: scale info, right: mode badges
  display.setTextSize(1);
  
  if (hasStatus) {
    // Status message on the left
    display.setCursor(0, 0);
    display.print(g_statusMessage);
  } else {
    // Scale info on the left (abbreviated)
    display.setCursor(0, 0);
    display.print(getNoteName(getCurrentRootNote()));
    display.print(" ");
    display.print(getScaleAbbreviation(getCurrentScaleName()));
  }
  
  // Mode indicators on the top right
  int badgeX = SCREEN_WIDTH - 2; // Start from right edge with small margin
  
  if (isAutoVoicingMode()) {
    // Draw "A" badge with circle (same style as Bass badge)
    display.fillCircle(badgeX - 5, 6, 5, SSD1306_WHITE);
    display.setTextColor(SSD1306_BLACK, SSD1306_WHITE);
    display.setTextSize(1);
    display.setCursor(badgeX - 7, 3);
    display.print("A");
    display.setTextColor(SSD1306_WHITE); // Reset to white text
    badgeX -= 14; // Move left for next badge
  }
  
  if (isBassMode()) {
    // Draw "B" badge with circle (aligned vertically with AV oval)
    display.fillCircle(badgeX - 5, 6, 5, SSD1306_WHITE);
    display.setTextColor(SSD1306_BLACK, SSD1306_WHITE);
    display.setTextSize(1);
    display.setCursor(badgeX - 7, 3);
    display.print("B");
    display.setTextColor(SSD1306_WHITE); // Reset to white text
  }
  
  // Middle: chord name with slash notation (centered)
  if (displayName.length() > 0) {
    // Use smaller text if name is too long
    if (displayName.length() > 9) {
      display.setTextSize(1);
      int16_t x1, y1;
      uint16_t w, h;
      display.getTextBounds(displayName, 0, 0, &x1, &y1, &w, &h);
      int cursorX = (SCREEN_WIDTH - w) / 2;
      display.setCursor(cursorX, 28);
    } else {
      display.setTextSize(2);
      int16_t x1, y1;
      uint16_t w, h;
      display.getTextBounds(displayName, 0, 0, &x1, &y1, &w, &h);
      int cursorX = (SCREEN_WIDTH - w) / 2;
      display.setCursor(cursorX, 25);
    }
    display.print(displayName);
  }
  
  // Show chord history (centered at the bottom)
  int histCount = getChordHistoryCount();
  if (histCount > 0) {
    display.setTextSize(1);
    
    // Build history string
    String historyStr = "< ";
    int toShow = min(5, histCount);
    for (int i = 0; i < toShow; i++) {
      if (i > 0) historyStr += "-";
      int deg = getChordHistoryDegree(i);
      if (deg >= 0 && deg <= 6) {
        historyStr += String(deg + 1); // Display as 1-7 instead of 0-6
      }
    }
    
    // Center the history text
    int16_t x1, y1;
    uint16_t w, h;
    display.getTextBounds(historyStr, 0, 0, &x1, &y1, &w, &h);
    int cursorX = (SCREEN_WIDTH - w) / 2;
    display.setCursor(cursorX, 56);
    display.print(historyStr);
  }
  
  display.display();
}

void showStatus(String message, unsigned long durationMs) {
  // Set timed message - it will be shown on the next updateDisplay() call
  g_statusMessage = message;
  g_statusUntil = millis() + durationMs;
}

String getScaleAbbreviation(String fullName) {
  // Abbreviate scale names to first 3 characters for compact display
  // Special cases for multi-word scales
  if (fullName == "Harmonic Minor") return "H.Min";
  if (fullName == "Melodic Minor") return "M.Min";
  
  if (fullName.length() <= 4) return fullName; // Already short enough
  return fullName.substring(0, 3);
}

String getNoteName(int noteNumber) {
  const char* noteNames[] = {"C", "C#", "D", "D#", "E", "F", "F#", "G", "G#", "A", "A#", "B"};
  return noteNames[noteNumber % 12];
}